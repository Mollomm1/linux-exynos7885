## Documentation/devicetree/bindings/display/panel/samsung,gta3xl-hx8279d.yaml
```yaml
# SPDX-License-Identifier: (GPL-2.0-only OR BSD-2-Clause)
%YAML 1.2
---
$id: http://devicetree.org/schemas/display/panel/samsung,gta3xl-hx8279d.yaml#
$schema: http://devicetree.org/meta-schemas/core.yaml#

title: Himax HX8279D panel of the Samsung Galaxy Tab A 10.1 (2019)

maintainers:
  - Mollomm1 <68751598+Mollomm1@users.noreply.github.com>

description:
  1200x1920 video-mode MIPI DSI panel with a Himax HX8279D controller, used
  in the Samsung SM-T510. Its backlight is controlled over DSI.

allOf:
  - $ref: panel-common.yaml#

properties:
  compatible:
    const: samsung,gta3xl-hx8279d

  reg:
    maxItems: 1

  port: true
  reset-gpios: true

  ldo-gpios:
    maxItems: 1
    description: Enable of the panel LDO supply, switched on first.

  buck-gpios:
    maxItems: 1
    description: Enable of the panel buck supply, switched on second.

required:
  - compatible
  - reg
  - port
  - reset-gpios
  - ldo-gpios
  - buck-gpios

additionalProperties: false

examples:
  - |
    #include <dt-bindings/gpio/gpio.h>

    dsi {
        #address-cells = <1>;
        #size-cells = <0>;

        panel@0 {
            compatible = "samsung,gta3xl-hx8279d";
            reg = <0>;
            reset-gpios = <&gpg1 7 GPIO_ACTIVE_LOW>;
            ldo-gpios = <&gpg2 6 GPIO_ACTIVE_HIGH>;
            buck-gpios = <&gpg2 7 GPIO_ACTIVE_HIGH>;

            port {
                endpoint {
                    remote-endpoint = <&dsi_out>;
                };
            };
        };
    };
```

## Documentation/devicetree/bindings/display/samsung/samsung,exynos7885-dpu.yaml
```yaml
# SPDX-License-Identifier: (GPL-2.0-only OR BSD-2-Clause)
%YAML 1.2
---
$id: http://devicetree.org/schemas/display/samsung/samsung,exynos7885-dpu.yaml#
$schema: http://devicetree.org/meta-schemas/core.yaml#

title: Samsung Exynos7885 display processing unit

maintainers:
  - Mollomm1 <68751598+Mollomm1@users.noreply.github.com>

description: |
  DECON0 and the IDMA_G0 pixel DMA channel of the Exynos7885 DPU. The
  binding describes the pipeline that the bootloader leaves running in DSI
  video mode, with the panel timing it was programmed for. Its output goes
  to the DSI host through the port.

properties:
  compatible:
    const: samsung,exynos7885-dpu

  reg:
    minItems: 2
    items:
      - description: DECON0 registers
      - description: IDMA_G0 registers, the scanout channel
      - description: IDMA_G1 registers, for an overlay plane
      - description: IDMA_GF registers, for a cursor plane

  reg-names:
    minItems: 2
    items:
      - const: decon
      - const: idma-g0
      - const: idma-g1
      - const: idma-gf

  interrupts:
    items:
      - description: DECON0 frame start

  interrupt-names:
    items:
      - const: frame-start

  power-domains:
    maxItems: 1

  iommus:
    maxItems: 1

  memory-region:
    maxItems: 1
    description:
      The framebuffer the bootloader scans out. With an IOMMU, the region
      needs an identity mapping (iommu-addresses) for this device, since
      the scanout continues from it while the IOMMU is enabled.

  panel-timing:
    $ref: /schemas/display/panel/panel-timing.yaml#

  port:
    $ref: /schemas/graph.yaml#/properties/port
    description: Output to the DSI host.

required:
  - compatible
  - reg
  - reg-names
  - interrupts
  - interrupt-names
  - panel-timing
  - port

additionalProperties: false

examples:
  - |
    #include <dt-bindings/interrupt-controller/arm-gic.h>

    display-controller@14860000 {
        compatible = "samsung,exynos7885-dpu";
        reg = <0x14860000 0x10000>, <0x148b1000 0x1000>,
              <0x148b2000 0x1000>, <0x148b3000 0x1000>;
        reg-names = "decon", "idma-g0", "idma-g1", "idma-gf";
        interrupts = <GIC_SPI 114 IRQ_TYPE_LEVEL_HIGH>;
        interrupt-names = "frame-start";

        port {
            endpoint {
                remote-endpoint = <&dsi_in>;
            };
        };

        panel-timing {
            clock-frequency = <164976000>;
            hactive = <1200>;
            vactive = <1920>;
            hfront-porch = <150>;
            hback-porch = <40>;
            hsync-len = <10>;
            vfront-porch = <22>;
            vback-porch = <18>;
            vsync-len = <4>;
        };
    };
```

## Documentation/devicetree/bindings/display/samsung/samsung,exynos7885-dsim.yaml
```yaml
# SPDX-License-Identifier: (GPL-2.0-only OR BSD-2-Clause)
%YAML 1.2
---
$id: http://devicetree.org/schemas/display/samsung/samsung,exynos7885-dsim.yaml#
$schema: http://devicetree.org/meta-schemas/core.yaml#

title: Samsung Exynos7885 MIPI DSI host (DSIM)

maintainers:
  - Mollomm1 <68751598+Mollomm1@users.noreply.github.com>

description: |
  DSIM of the Exynos7885 display processing unit. Its input is the DPU
  (port 0) and its output a DSI panel (port 1), which is also described
  as a child node of the host.

allOf:
  - $ref: /schemas/display/dsi-controller.yaml#

properties:
  compatible:
    const: samsung,exynos7885-dsim

  reg:
    maxItems: 1

  interrupts:
    maxItems: 1

  power-domains:
    maxItems: 1

  samsung,pmu-syscon:
    $ref: /schemas/types.yaml#/definitions/phandle
    description:
      PMU system controller, which isolates the D-PHY while the link is
      off.

  ports:
    $ref: /schemas/graph.yaml#/properties/ports

    properties:
      port@0:
        $ref: /schemas/graph.yaml#/properties/port
        description: Input from the DPU.

      port@1:
        $ref: /schemas/graph.yaml#/properties/port
        description: Output to the DSI panel.

    required:
      - port@0
      - port@1

required:
  - compatible
  - reg
  - samsung,pmu-syscon
  - ports

unevaluatedProperties: false

examples:
  - |
    #include <dt-bindings/interrupt-controller/arm-gic.h>

    dsi@14870000 {
        compatible = "samsung,exynos7885-dsim";
        reg = <0x14870000 0x100>;
        interrupts = <GIC_SPI 125 IRQ_TYPE_LEVEL_HIGH>;
        samsung,pmu-syscon = <&pmu_system_controller>;
        #address-cells = <1>;
        #size-cells = <0>;

        panel@0 {
            compatible = "samsung,gta3xl-hx8279d";
            reg = <0>;

            port {
                panel_in: endpoint {
                    remote-endpoint = <&dsi_out>;
                };
            };
        };

        ports {
            #address-cells = <1>;
            #size-cells = <0>;

            port@0 {
                reg = <0>;
                dsi_in: endpoint {
                    remote-endpoint = <&dpu_out>;
                };
            };

            port@1 {
                reg = <1>;
                dsi_out: endpoint {
                    remote-endpoint = <&panel_in>;
                };
            };
        };
    };
```

## Documentation/devicetree/bindings/firmware/samsung,exynos7885-acpm-ipc.yaml
```yaml
# SPDX-License-Identifier: (GPL-2.0-only OR BSD-2-Clause)
%YAML 1.2
---
$id: http://devicetree.org/schemas/firmware/samsung,exynos7885-acpm-ipc.yaml#
$schema: http://devicetree.org/meta-schemas/core.yaml#

title: Samsung Exynos7885 ACPM IPC

maintainers:
  - Mollomm1 <mollomm1@users.noreply.github.com>

description:
  The ACPM firmware uses the APM SRAM for its channel descriptors and
  message rings. Its framework descriptor is at offset 0x4b80 in the SRAM.

properties:
  compatible:
    const: samsung,exynos7885-acpm-ipc

  mboxes:
    maxItems: 1

  shmem:
    $ref: /schemas/types.yaml#/definitions/phandle
    description: APM SRAM region containing channel descriptors and rings.

required:
  - compatible
  - mboxes
  - shmem

additionalProperties: false

examples:
  - |
    power-management {
        compatible = "samsung,exynos7885-acpm-ipc";
        mboxes = <&ap2apm_mailbox>;
        shmem = <&apm_sram>;
    };
```

## Documentation/devicetree/bindings/input/touchscreen/st,fts1ba90a.yaml
```yaml
# SPDX-License-Identifier: (GPL-2.0-only OR BSD-2-Clause)
%YAML 1.2
---
$id: http://devicetree.org/schemas/input/touchscreen/st,fts1ba90a.yaml#
$schema: http://devicetree.org/meta-schemas/core.yaml#

title: STMicroelectronics FTS1BA90A touchscreen controller

maintainers:
  - Mollomm1 <68751598+Mollomm1@users.noreply.github.com>

description:
  The FTS1BA90A is an I2C capacitive touchscreen controller, used in the
  Samsung Galaxy Tab A 10.1 (2019). It has no reset line; it is reset by
  switching its supplies off and on.

allOf:
  - $ref: touchscreen.yaml#

properties:
  compatible:
    const: st,fts1ba90a

  reg:
    maxItems: 1

  interrupts:
    maxItems: 1

  avdd-supply:
    description: 3.3 V analog supply.

  vdd-supply:
    description: 1.8 V digital supply.

  panel:
    description:
      The panel over which the touchscreen lies. The controller stops
      sensing while the panel is off.

  pinctrl-0: true
  pinctrl-1: true

  pinctrl-names:
    items:
      - const: default
      - const: sleep

  wakeup-source: true

required:
  - compatible
  - reg
  - interrupts
  - avdd-supply
  - vdd-supply

unevaluatedProperties: false

examples:
  - |
    #include <dt-bindings/interrupt-controller/irq.h>

    i2c {
        #address-cells = <1>;
        #size-cells = <0>;

        touchscreen@49 {
            compatible = "st,fts1ba90a";
            reg = <0x49>;
            interrupt-parent = <&gpa0>;
            interrupts = <0 IRQ_TYPE_LEVEL_LOW>;
            avdd-supply = <&tsp_avdd>;
            vdd-supply = <&tsp_dvdd>;
            panel = <&panel>;
            touchscreen-size-x = <1200>;
            touchscreen-size-y = <1920>;
            wakeup-source;
        };
    };
```

## Documentation/devicetree/bindings/mailbox/samsung,exynos7885-acpm-mbox.yaml
```yaml
# SPDX-License-Identifier: (GPL-2.0-only OR BSD-2-Clause)
%YAML 1.2
---
$id: http://devicetree.org/schemas/mailbox/samsung,exynos7885-acpm-mbox.yaml#
$schema: http://devicetree.org/meta-schemas/core.yaml#

title: Samsung Exynos7885 ACPM mailbox

maintainers:
  - Mollomm1 <mollomm1@users.noreply.github.com>

description:
  Doorbell mailbox between the application processor and the ACPM firmware.
  The AP generates an APM interrupt by writing bit 16 plus the channel ID
  to the INTGR0 register at offset 0x08.

properties:
  compatible:
    const: samsung,exynos7885-acpm-mbox

  reg:
    maxItems: 1

  '#mbox-cells':
    const: 0

required:
  - compatible
  - reg
  - '#mbox-cells'

additionalProperties: false

examples:
  - |
    mailbox@11c40000 {
        compatible = "samsung,exynos7885-acpm-mbox";
        reg = <0x11c40000 0x1000>;
        #mbox-cells = <0>;
    };
```

## Documentation/devicetree/bindings/media/i2c/samsung,s5k4ha.yaml
```yaml
# SPDX-License-Identifier: (GPL-2.0-only OR BSD-2-Clause)
%YAML 1.2
---
$id: http://devicetree.org/schemas/media/i2c/samsung,s5k4ha.yaml#
$schema: http://devicetree.org/meta-schemas/core.yaml#

title: Samsung S5K4HA and S5K5E9 raw Bayer image sensors

maintainers:
  - Mollomm1 <68751598+Mollomm1@users.noreply.github.com>

description:
  The S5K4HA is an 8 megapixel sensor with a 4-lane MIPI CSI-2 output, the
  S5K5E9 a 5 megapixel sensor with a 2-lane output. Both are controlled over
  I2C and run from a 26 MHz master clock.

allOf:
  - $ref: /schemas/media/video-interface-devices.yaml#

properties:
  compatible:
    enum:
      - samsung,s5k4ha
      - samsung,s5k5e9

  reg:
    maxItems: 1

  clocks:
    maxItems: 1

  reset-gpios:
    maxItems: 1

  vana-supply:
    description: Analogue 2.8 V supply.

  vdig-supply:
    description: Digital core supply.

  vio-supply:
    description: Interface 1.8 V supply.

  port:
    $ref: /schemas/graph.yaml#/$defs/port-base
    additionalProperties: false

    properties:
      endpoint:
        $ref: /schemas/media/video-interfaces.yaml#
        unevaluatedProperties: false

        required:
          - data-lanes
          - link-frequencies

required:
  - compatible
  - reg
  - clocks
  - reset-gpios
  - vana-supply
  - vdig-supply
  - vio-supply
  - port

unevaluatedProperties: false

examples:
  - |
    #include <dt-bindings/gpio/gpio.h>

    i2c {
        #address-cells = <1>;
        #size-cells = <0>;

        camera@2d {
            compatible = "samsung,s5k4ha";
            reg = <0x2d>;
            clocks = <&cmu_top 79>;
            reset-gpios = <&gpg3 4 GPIO_ACTIVE_LOW>;
            vana-supply = <&rcam_vana>;
            vdig-supply = <&rcam_vdig>;
            vio-supply = <&cam_vio>;
            orientation = <1>;

            port {
                rcam_out: endpoint {
                    remote-endpoint = <&csis1_in>;
                    data-lanes = <1 2 3 4>;
                    link-frequencies = /bits/ 64 <335400000>;
                };
            };
        };
    };
...
```

## Documentation/devicetree/bindings/media/samsung,exynos7885-csis.yaml
```yaml
# SPDX-License-Identifier: (GPL-2.0-only OR BSD-2-Clause)
%YAML 1.2
---
$id: http://devicetree.org/schemas/media/samsung,exynos7885-csis.yaml#
$schema: http://devicetree.org/meta-schemas/core.yaml#

title: Samsung Exynos7885 MIPI CSI-2 receiver (CSIS v5)

maintainers:
  - Mollomm1 <68751598+Mollomm1@users.noreply.github.com>

description:
  Each CSIS instance receives one camera sensor over its own D-PHY and can
  write the received frames to memory with a built-in DMA, without the
  camera ISP. The D-PHY is isolated by the PMU and held in reset by the CAM
  system registers; the instances share an arbiter and SRAM for their DMA.

properties:
  compatible:
    const: samsung,exynos7885-csis

  reg:
    maxItems: 1

  interrupts:
    maxItems: 1

  samsung,pmu-syscon:
    $ref: /schemas/types.yaml#/definitions/phandle-array
    items:
      - items:
          - description: phandle to the PMU system controller
          - description: offset of the D-PHY isolation register
    description: PMU register that isolates the D-PHY of this instance.

  samsung,sysreg:
    $ref: /schemas/types.yaml#/definitions/phandle-array
    items:
      - items:
          - description: phandle to the CAM system registers
          - description: offset of the D-PHY reset register
          - description: reset bit of this instance's D-PHY
    description: CAM system register bit that releases the D-PHY reset.

  samsung,csis-dma:
    $ref: /schemas/types.yaml#/definitions/phandle-array
    items:
      - items:
          - description: phandle to the common CSIS DMA block
          - description: index of this instance's DMA in the common block
    description: Common DMA arbitration and SRAM shared by the instances.

  port:
    $ref: /schemas/graph.yaml#/$defs/port-base
    unevaluatedProperties: false
    description: Input from the sensor.

    properties:
      endpoint:
        $ref: video-interfaces.yaml#
        unevaluatedProperties: false

        properties:
          data-lanes:
            minItems: 1
            maxItems: 4

        required:
          - data-lanes

required:
  - compatible
  - reg
  - interrupts
  - samsung,pmu-syscon
  - samsung,sysreg
  - samsung,csis-dma
  - port

additionalProperties: false

examples:
  - |
    #include <dt-bindings/interrupt-controller/arm-gic.h>

    csis@14410000 {
        compatible = "samsung,exynos7885-csis";
        reg = <0x14410000 0x2000>;
        interrupts = <GIC_SPI 298 IRQ_TYPE_LEVEL_HIGH>;
        samsung,pmu-syscon = <&pmu_system_controller 0x680>;
        samsung,sysreg = <&syscon_cam 0x840 8>;
        samsung,csis-dma = <&csis_dma 1>;

        port {
            csis1_in: endpoint {
                remote-endpoint = <&rcam_out>;
                data-lanes = <1 2 3 4>;
            };
        };
    };
...
```
