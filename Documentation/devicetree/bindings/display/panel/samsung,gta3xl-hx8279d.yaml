## Documentation/devicetree/bindings/sound/samsung,exynos7885-tfa9896.yaml
```yaml
# SPDX-License-Identifier: (GPL-2.0-only OR BSD-2-Clause)
%YAML 1.2
---
$id: http://devicetree.org/schemas/sound/samsung,exynos7885-tfa9896.yaml#
$schema: http://devicetree.org/meta-schemas/core.yaml#

title: Samsung Exynos7885 GTA3XL Wi-Fi TFA9896 speaker sound card

maintainers:
  - Mollomm1 <Mollomm1@users.noreply.github.com>

description:
  Sound card for the Exynos7885-based Samsung GTA3XL Wi-Fi tablet. A single
  ABOX UAIF3 playback DAI feeds the two TFA9896 amplifiers over a shared TDM
  bus. The amplifier slot assignments are supplied by their firmware data.

allOf:
  - $ref: sound-card-common.yaml#

properties:
  compatible:
    const: samsung,exynos7885-gta3xlwifi-audio

  cpu:
    type: object
    additionalProperties: false
    properties:
      sound-dai:
        $ref: /schemas/types.yaml#/definitions/phandle-array
        maxItems: 1
        description: Phandle to the ABOX UAIF3 playback DAI.
    required:
      - sound-dai

  codecs:
    type: object
    additionalProperties: false
    properties:
      sound-dai:
        $ref: /schemas/types.yaml#/definitions/phandle-array
        minItems: 2
        maxItems: 2
        description: Phandles to the right and left TFA9896 codec DAIs.
    required:
      - sound-dai

required:
  - compatible
  - audio-routing
  - cpu
  - codecs

unevaluatedProperties: false

examples:
  - |
    sound {
        compatible = "samsung,exynos7885-gta3xlwifi-audio";
        model = "Samsung Galaxy Tab A 10.1 Speaker";
        status = "disabled";
        audio-routing = "Speaker", "Right Speaker OUT",
                        "Speaker", "Left Speaker OUT";

        cpu {
            sound-dai = <&abox_audio>;
        };

        codecs {
            sound-dai = <&amp_right>, <&amp_left>;
        };
    };
```

## Documentation/devicetree/bindings/usb/samsung,s2mm005.yaml
```yaml
# SPDX-License-Identifier: GPL-2.0-only OR BSD-2-Clause
%YAML 1.2
---
$id: http://devicetree.org/schemas/usb/samsung,s2mm005.yaml#
$schema: http://devicetree.org/meta-schemas/core.yaml#

title: Samsung S2MM005 Type-C port controller

maintainers:
  - Mollomm1 <68751598+Mollomm1@users.noreply.github.com>

description:
  Type-C controller with resident Power Delivery firmware. The host controls
  an external USB data switch and VBUS boost converter according to the
  firmware's independent data and power roles.

properties:
  compatible:
    const: samsung,s2mm005
  reg:
    maxItems: 1
  interrupts:
    maxItems: 1
  vbus-supply: true
  mux-controls:
    maxItems: 1
  mux-control-names:
    const: usb
  wakeup-source: true
  connector:
    $ref: /schemas/connector/usb-connector.yaml#
    unevaluatedProperties: false

required:
  - compatible
  - reg
  - interrupts
  - vbus-supply
  - mux-controls
  - mux-control-names
  - connector

additionalProperties: false
```

## drivers/gpu/drm/exynos7885/Kconfig
```kconfig
# SPDX-License-Identifier: GPL-2.0-only
config DRM_EXYNOS7885_DPU
	tristate "DRM support for the Samsung Exynos7885 display processing unit"
	depends on DRM && OF && (ARCH_EXYNOS || COMPILE_TEST)
	select DRM_BRIDGE_CONNECTOR
	select DRM_CLIENT_SELECTION
	select DRM_DISPLAY_HELPER
	select DRM_KMS_HELPER
	select DRM_GEM_DMA_HELPER
	select DRM_PANEL_BRIDGE
	select VIDEOMODE_HELPERS
	help
	  Choose this option to drive the display of Exynos7885/7904 devices
	  through DECON0 and IDMA_G0, taking over the pipeline that the
	  bootloader left running in DSI video mode.

	  If M is selected, the module will be called exynos7885-dpu.

config DRM_EXYNOS7885_DSIM
	tristate "Samsung Exynos7885 MIPI DSI host"
	depends on DRM && OF && (ARCH_EXYNOS || COMPILE_TEST)
	select DRM_MIPI_DSI
	select DRM_PANEL_BRIDGE
	help
	  Choose this option for the Exynos7885 DSIM: a MIPI DSI host for
	  sending panel commands over the video-mode link the bootloader left
	  running, and the DRM bridge between the DPU and the panel.

	  If M is selected, the module will be called exynos7885-dsim.
```

## drivers/media/platform/samsung/exynos7885-csis/Kconfig
```kconfig
# SPDX-License-Identifier: GPL-2.0-only

config VIDEO_EXYNOS7885_CSIS
	tristate "Samsung Exynos7885 MIPI CSI-2 receiver"
	depends on V4L_PLATFORM_DRIVERS
	depends on VIDEO_DEV && OF
	depends on ARCH_EXYNOS || COMPILE_TEST
	select MEDIA_CONTROLLER
	select VIDEO_V4L2_SUBDEV_API
	select V4L2_FWNODE
	select VIDEOBUF2_DMA_CONTIG
	select MFD_SYSCON
	help
	  Driver for the CSIS v5 MIPI CSI-2 receivers of Samsung Exynos7885
	  SoCs. Raw Bayer frames from a camera sensor are written to memory
	  by the receiver's own DMA, without the camera ISP.

	  To compile this driver as a module, choose M here: the module
	  will be called exynos7885-csis.
```
