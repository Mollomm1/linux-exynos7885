## Documentation/devicetree/bindings/mfd/samsung,s2mu005.yaml
```yaml
# SPDX-License-Identifier: GPL-2.0-only OR BSD-2-Clause
%YAML 1.2
---
$id: http://devicetree.org/schemas/mfd/samsung,s2mu005.yaml#
$schema: http://devicetree.org/meta-schemas/core.yaml#

title: Samsung S2MU005 interface PMIC

maintainers:
  - Mollomm1 <68751598+Mollomm1@users.noreply.github.com>

description:
  Interface PMIC containing a charger, OTG boost converter, and USB data switch.
  The fuel gauge has a separate I2C address and is not a child of this device.

properties:
  compatible:
    const: samsung,s2mu005
  reg:
    maxItems: 1
  interrupts:
    maxItems: 1
  mux-controller:
    $ref: /schemas/mux/samsung,s2mu005-mux.yaml#
  charger:
    $ref: /schemas/power/supply/samsung,s2mu005-charger.yaml#

required:
  - compatible
  - reg
  - interrupts

additionalProperties: false
```

## Documentation/devicetree/bindings/mux/samsung,s2mu005-mux.yaml
```yaml
# SPDX-License-Identifier: GPL-2.0-only OR BSD-2-Clause
%YAML 1.2
---
$id: http://devicetree.org/schemas/mux/samsung,s2mu005-mux.yaml#
$schema: http://devicetree.org/meta-schemas/core.yaml#

title: Samsung S2MU005 USB data switch

maintainers:
  - Mollomm1 <68751598+Mollomm1@users.noreply.github.com>

description:
  Child of the S2MU005 PMIC. State 0 opens D+/D-; state 1 routes them to
  the application processor. The idle state is open.

properties:
  compatible:
    const: samsung,s2mu005-mux
  '#mux-control-cells':
    const: 0

required:
  - compatible
  - '#mux-control-cells'

additionalProperties: false
```

## Documentation/devicetree/bindings/power/supply/samsung,s2mu005-charger.yaml
```yaml
# SPDX-License-Identifier: GPL-2.0-only OR BSD-2-Clause
%YAML 1.2
---
$id: http://devicetree.org/schemas/power/supply/samsung,s2mu005-charger.yaml#
$schema: http://devicetree.org/meta-schemas/core.yaml#

title: Samsung S2MU005 charger and OTG boost converter

maintainers:
  - Mollomm1 <68751598+Mollomm1@users.noreply.github.com>

description:
  Charger child of the S2MU005 PMIC. Charge and boost modes are mutually
  exclusive. Battery temperature is measured by an external ADC and NTC.

properties:
  compatible:
    const: samsung,s2mu005-charger
  samsung,usb-port:
    $ref: /schemas/types.yaml#/definitions/phandle
    description:
      Type-C controller reporting the available sink power. This is resolved
      after probe because that controller consumes this charger's VBUS regulator.
  monitored-battery: true
  io-channels:
    maxItems: 1
  io-channel-names:
    const: battery-temperature
  samsung,temperature-adc-limits:
    $ref: /schemas/types.yaml#/definitions/uint32-array
    items:
      - description: Hot cutoff, raw ADC reading
      - description: Recovery from hot, raw ADC reading
      - description: Recovery from cold, raw ADC reading
      - description: Cold cutoff, raw ADC reading
    description:
      Strictly increasing raw readings for an NTC whose reading decreases
      with increasing temperature. Both cutoff boundaries inhibit charging.
  vbus:
    $ref: /schemas/regulator/regulator.yaml#
    unevaluatedProperties: false

required:
  - compatible
  - samsung,usb-port
  - monitored-battery
  - io-channels
  - io-channel-names
  - samsung,temperature-adc-limits
  - vbus

additionalProperties: false
```

## Documentation/devicetree/bindings/power/supply/samsung,s2mu005-fg.yaml
```yaml
# SPDX-License-Identifier: GPL-2.0-only OR BSD-2-Clause
%YAML 1.2
---
$id: http://devicetree.org/schemas/power/supply/samsung,s2mu005-fg.yaml#
$schema: http://devicetree.org/meta-schemas/core.yaml#

title: Samsung S2MU005 fuel gauge

maintainers:
  - Mollomm1 <68751598+Mollomm1@users.noreply.github.com>

properties:
  compatible:
    const: samsung,s2mu005-fg
  reg:
    maxItems: 1
  interrupts:
    maxItems: 1

required:
  - compatible
  - reg

additionalProperties: false
```

## Documentation/devicetree/bindings/regulator/samsung,s2mpu08-acpm-buck.yaml
```yaml
# SPDX-License-Identifier: (GPL-2.0-only OR BSD-2-Clause)
%YAML 1.2
---
$id: http://devicetree.org/schemas/regulator/samsung,s2mpu08-acpm-buck.yaml#
$schema: http://devicetree.org/meta-schemas/core.yaml#

title: Samsung S2MPU08 buck and LDO control over ACPM

maintainers:
  - Mollomm1 <68751598+Mollomm1@users.noreply.github.com>

description:
  On Exynos7885 boards the S2MPU08 PMIC is reached through ACPM. This
  describes the output voltage control of one buck, BUCK2 (vdd_cpucl0,
  the A73 cluster), BUCK3 (vdd_cpucl12, the A53 clusters) or BUCK5
  (vdd_g3d, the Mali GPU). Switching the buck on and off stays with the
  PMU. It also describes LDO2 and LDO35, the SD card I/O and card
  supplies, which are switched on and off as well as set.

allOf:
  - $ref: regulator.yaml#

properties:
  compatible:
    enum:
      - samsung,s2mpu08-acpm-buck2
      - samsung,s2mpu08-acpm-buck3
      - samsung,s2mpu08-acpm-buck5
      - samsung,s2mpu08-acpm-ldo2
      - samsung,s2mpu08-acpm-ldo35

  samsung,acpm-ipc:
    $ref: /schemas/types.yaml#/definitions/phandle-array
    items:
      - items:
          - description: ACPM IPC node
          - description: ACPM channel of the PMIC
    description: ACPM interface and channel used to reach the PMIC.

required:
  - compatible
  - samsung,acpm-ipc

unevaluatedProperties: false

examples:
  - |
    regulator-vdd-g3d {
        compatible = "samsung,s2mpu08-acpm-buck5";
        samsung,acpm-ipc = <&acpm_ipc 2>;
        regulator-name = "vdd_g3d";
        regulator-min-microvolt = <750000>;
        regulator-max-microvolt = <900000>;
    };
```

## Documentation/devicetree/bindings/soc/samsung/samsung,exynos7885-wifibt.yaml
```yaml
# SPDX-License-Identifier: (GPL-2.0-only OR BSD-2-Clause)
%YAML 1.2
---
$id: http://devicetree.org/schemas/soc/samsung/samsung,exynos7885-wifibt.yaml#
$schema: http://devicetree.org/meta-schemas/core.yaml#

title: Samsung Exynos7885 WiFi and Bluetooth subsystem

maintainers:
  - Mollomm1 <68751598+Mollomm1@users.noreply.github.com>

description: |
  Integrated wireless subsystem with R4 and M4 mailbox banks and a shared
  DRAM region. The PMU controls subsystem power and reset. Firmware and host
  communicate through mailboxes and the reserved memory region.

properties:
  compatible:
    const: samsung,exynos7885-wifibt

  reg:
    minItems: 2
    maxItems: 3
    description: |
      R4 and M4 mailbox resources, optionally preceded by the CP mailbox used
      for shared-regulator coordination.

  reg-names:
    oneOf:
      - items:
          - const: r4
          - const: m4
        minItems: 2
        maxItems: 2
      - items:
          - const: cp
          - const: r4
          - const: m4
        minItems: 3
        maxItems: 3

  interrupts:
    items:
      - description: Mailbox to application processor
      - description: Subsystem alive
      - description: Watchdog

  interrupt-names:
    items:
      - const: mbox
      - const: alive
      - const: watchdog

  samsung,pmu-syscon:
    $ref: /schemas/types.yaml#/definitions/phandle
    description: PMU system controller

  memory-region:
    maxItems: 1
    description: Reserved shared DRAM, marked no-map

required:
  - compatible
  - reg
  - reg-names
  - interrupts
  - interrupt-names
  - samsung,pmu-syscon
  - memory-region

additionalProperties: false
```

## Documentation/devicetree/bindings/soc/samsung/samsung,scsc-wifibt.yaml
```yaml
# SPDX-License-Identifier: (GPL-2.0-only OR BSD-2-Clause)
%YAML 1.2
---
$id: http://devicetree.org/schemas/soc/samsung/samsung,scsc-wifibt.yaml#
$schema: http://devicetree.org/meta-schemas/core.yaml#

title: Samsung SLSI SCSC (mx140/Lassen) WiFi/BT mailbox

maintainers:
  - T510 mainlining project

description: |
  Mailbox interface to the Samsung SLSI SCSC WiFi/BT firmware block
  (mx140/Lassen) found on Exynos7885/7904 SoCs. The block runs its own
  firmware (R4/M4 cores) and communicates with the AP over the mailbox
  registers plus a shared-memory carveout. Power sequencing goes through
  the PMU system controller.

  This binding currently covers the minimal probe-only stage (register
  mapping, interrupts, shared memory, PMU state readout). Booting the
  firmware and the 802.11 interface are future work.

properties:
  compatible:
    const: samsung,scsc-wifibt

  reg:
    items:
      - description: R4 mailbox bank
      - description: M4 mailbox bank

  reg-names:
    items:
      - const: r4
      - const: m4

  interrupts:
    items:
      - description: mailbox interrupt (WLBT to AP)
      - description: alive interrupt
      - description: watchdog interrupt

  interrupt-names:
    items:
      - const: MBOX
      - const: ALIVE
      - const: WDOG

  samsung,syscon-phandle:
    $ref: /schemas/types.yaml#/definitions/phandle
    description:
      Phandle to the PMU system controller (for WIFI_STAT readout and,
      later, power sequencing).

  memory-region:
    maxItems: 1
    description:
      Phandle to the wifibt_if shared-memory reserved-memory region.

required:
  - compatible
  - reg
  - interrupts
  - interrupt-names
  - samsung,syscon-phandle
  - memory-region

additionalProperties: false

examples:
  - |
    #include <dt-bindings/interrupt-controller/irq.h>

    scsc-wifibt@120c0000 {
        compatible = "samsung,scsc-wifibt";
        reg = <0x0 0x120c0000 0x180>,
              <0x0 0x120e0000 0x180>;
        reg-names = "r4", "m4";
        interrupts = <0 57 4>, <0 21 4>, <0 286 4>;
        interrupt-names = "MBOX", "ALIVE", "WDOG";
        samsung,syscon-phandle = <&pmu_system_controller>;
        memory-region = <&wifibt_if>;
    };
```

## Documentation/devicetree/bindings/sound/samsung,cod3035x.yaml
```yaml
# SPDX-License-Identifier: (GPL-2.0-only OR BSD-2-Clause)
%YAML 1.2
---
$id: http://devicetree.org/schemas/sound/samsung,cod3035x.yaml#
$schema: http://devicetree.org/meta-schemas/core.yaml#

title: Samsung COD3035X audio codec

maintainers:
  - Mollomm1 <Mollomm1@users.noreply.github.com>

description:
  Headphone and microphone codec inside the Samsung S2MPU08 PMIC package.
  It sits on the SPEEDY bus, which the APM firmware owns, so register
  accesses go through the ACPM IPC service. It exchanges I2S with an ABOX
  UAIF and runs from a master clock that ABOX provides while it streams.
  Its analog microphone inputs are the IN1L and IN2L widgets, with the
  MICBIAS1 supply for routing.

allOf:
  - $ref: dai-common.yaml#

properties:
  compatible:
    const: samsung,cod3035x

  samsung,acpm-ipc:
    $ref: /schemas/types.yaml#/definitions/phandle-array
    items:
      - items:
          - description: ACPM IPC node.
          - description: ACPM channel of the PMIC/codec register service.
    description: ACPM IPC provider and channel used for register accesses.

  clocks:
    maxItems: 1

  clock-names:
    const: mclk

  "#sound-dai-cells":
    const: 0

required:
  - compatible
  - samsung,acpm-ipc
  - clocks
  - clock-names
  - "#sound-dai-cells"

unevaluatedProperties: false

examples:
  - |
    audio-codec {
        compatible = "samsung,cod3035x";
        samsung,acpm-ipc = <&acpm_ipc 2>;
        clocks = <&abox>;
        clock-names = "mclk";
        #sound-dai-cells = <0>;
    };
```

## Documentation/devicetree/bindings/sound/samsung,exynos7885-abox.yaml
```yaml
# SPDX-License-Identifier: (GPL-2.0-only OR BSD-2-Clause)
%YAML 1.2
---
$id: http://devicetree.org/schemas/sound/samsung,exynos7885-abox.yaml#
$schema: http://devicetree.org/meta-schemas/core.yaml#

title: Samsung Exynos7885 ABOX audio processor

maintainers:
  - Mollomm1 <Mollomm1@users.noreply.github.com>

description: |
  The Exynos7885 audio processor has control registers, a system register
  aperture, and local SRAM. A reserved DRAM firmware region may be assigned
  through memory-region for the ABOX remote processor.

properties:
  compatible:
    const: samsung,exynos7885-abox

  reg:
    items:
      - description: ABOX control registers
      - description: Audio system registers
      - description: ABOX local SRAM
      - description: ABOX local GIC distributor
      - description: ABOX local GIC CPU interface

  reg-names:
    items:
      - const: sfr
      - const: sysreg
      - const: sram
      - const: gicd
      - const: gicc

  interrupts:
    maxItems: 1

  interrupt-names:
    items:
      - const: abox

  clocks:
    minItems: 8
    maxItems: 12

  clock-names:
    minItems: 8
    items:
      - const: pll
      - const: ca7
      - const: audif
      - const: uaif3-div
      - const: uaif3-mux
      - const: aclk
      - const: uaif3-bclk
      - const: uaif3-sync
      - const: uaif0-div
      - const: uaif0-mux
      - const: uaif0-bclk
      - const: uaif0-sync

  pinctrl-names:
    items:
      - const: active
      - const: idle

  pinctrl-0: true

  pinctrl-1: true

  memory-region:
    minItems: 1
    maxItems: 2
    description: Firmware DRAM carveout and optional PCM ring buffer.

  iommus:
    maxItems: 1

  samsung,bootargs:
    $ref: /schemas/types.yaml#/definitions/string
    description:
      Option string the firmware reads from SRAM at boot. The SM-T510 passes
      "init=ab0x vss=0"; without vss=0 the firmware writes to a modem voice
      buffer that WiFi-only boards do not map.

  samsung,bootargs-offset:
    $ref: /schemas/types.yaml#/definitions/uint32
    description: SRAM offset of samsung,bootargs, past the firmware image.

  power-domains:
    maxItems: 1
    description: DISPAUD power domain containing the ABOX processor.

  "#clock-cells":
    const: 0
    description:
      Codec master clock driven on the UAIF2 clock pin. It runs only while
      the ABOX firmware is up.

patternProperties:
  "^abox-audio$":
    type: object
    properties:
      compatible:
        const: samsung,exynos7885-abox-audio

      "#sound-dai-cells":
        description:
          With one cell, DAI 0 is UAIF3 (speaker amplifiers), DAI 1 is
          UAIF0 (headphone codec) and DAI 2 is the UAIF0 input (codec
          microphones).
        enum: [0, 1]

      status: true

    required:
      - compatible
      - "#sound-dai-cells"

    additionalProperties: false

  "^firmware-[a-z0-9-]+$":
    type: object
    properties:
      status: true

      samsung,name:
        $ref: /schemas/types.yaml#/definitions/string
        description: Firmware path passed to request_firmware().

      samsung,area:
        $ref: /schemas/types.yaml#/definitions/uint32
        const: 1
        description: Firmware is copied into the DRAM carveout.

      samsung,offset:
        $ref: /schemas/types.yaml#/definitions/uint32
        description: Byte offset within the DRAM carveout.

    required:
      - samsung,name
      - samsung,area
      - samsung,offset

    additionalProperties: false

required:
  - compatible
  - reg
  - reg-names
  - interrupts
  - interrupt-names
  - clocks
  - clock-names
  - power-domains

dependencies:
  samsung,bootargs: [ "samsung,bootargs-offset" ]

additionalProperties: false

examples:
  - |
    pd_dispaud: power-domain@11c84020 {
        compatible = "samsung,exynos7885-dispaud-pd";
        reg = <0x11c84020 0x20>;
        #power-domain-cells = <0>;
    };

    audio-controller@14a50000 {
        compatible = "samsung,exynos7885-abox";
        reg = <0x14a50000 0x10000>,
              <0x14820000 0x10000>,
              <0x14b00000 0x28000>,
              <0x14af1000 0x1000>,
              <0x14af2000 0x1004>;
        reg-names = "sfr", "sysreg", "sram", "gicd", "gicc";
        interrupts = <GIC_SPI 119 IRQ_TYPE_LEVEL_HIGH>;
        interrupt-names = "abox";
        clocks = <&cmu_dispaud 1>, <&cmu_dispaud 13>,
                 <&cmu_dispaud 2>, <&cmu_dispaud 3>,
                 <&cmu_dispaud 16>, <&cmu_dispaud 5>,
                 <&cmu_dispaud 7>, <&cmu_dispaud 8>;
        clock-names = "pll", "ca7", "audif", "uaif3-div",
                      "uaif3-mux", "aclk",
                      "uaif3-bclk", "uaif3-sync";
        power-domains = <&pd_dispaud>;
    };
...
```
